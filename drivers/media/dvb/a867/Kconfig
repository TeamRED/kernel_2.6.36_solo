## drivers/media/dvb/a867/Kconfig
```kconfig
config DVB_A867
	tristate "Avermedia A867 DVB receiver"
	depends on DVB_CORE && USB && I2C && INPUT
	help
	  Choose Y or M here if you have a device containing an AS102

	  To compile this driver as a module, choose M here
```

## drivers/net/wireless/rtl8712/Kconfig
```kconfig
config RTL8712U
	tristate "Realtek 8712 USB WiFi"
	depends on USB
        select WIRELESS_EXT
	select WEXT_SPY
	select WEXT_PRIV
	select CRYPTO
	select CRYPTO_AES
	---help---
	  Help message of RTL8712U
```
